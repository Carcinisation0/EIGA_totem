/ {
    combos {
        compatible = "zmk,combos";

        mouse {
            timeout-ms = <50>;
            key-positions = <0 1 2 3>;
            bindings = <&mo 6>;
            layers = <0 1>;
        };

        del {
            bindings = <&kp DEL>;
            key-positions = <2 1>;
            layers = <0 1>;
        };

        bspc1 {
            bindings = <&kp BACKSPACE>;
            key-positions = <3 2>;
            layers = <0 1>;
        };

        del_word1 {
            bindings = <&kp LC(BACKSPACE)>;
            key-positions = <1 2 3>;
            layers = <0>;
        };

        caps_left {
            bindings = <&kp CAPS>;
            key-positions = <24 23 22 21>;
            layers = <0>;
        };

        caps_right {
            bindings = <&kp CAPS>;
            key-positions = <27 28 29 30>;
            layers = <0>;
        };

        ctrl_c {
            bindings = <&kp LC(C)>;
            key-positions = <22 23>;
            layers = <0>;
        };

        ctrl_v {
            bindings = <&kp LC(V)>;
            key-positions = <24 23>;
            layers = <0>;
        };

        screen {
            bindings = <&kp LG(LS(S))>;
            key-positions = <22 23 24>;
            layers = <4>;
        };

        g1 {
            bindings = <&kp N1>;
            key-positions = <2 1>;
            layers = <2>;
        };

        g2 {
            bindings = <&kp N2>;
            key-positions = <3 2>;
            layers = <2>;
        };

        g3 {
            bindings = <&kp N3>;
            key-positions = <3 2 1>;
            layers = <2>;
        };

        numpad_comma {
            bindings = <&kp COMMA>;
            key-positions = <23 24>;
            layers = <1>;
        };

        numpad_dot {
            bindings = <&kp DOT>;
            key-positions = <22 23>;
            layers = <1>;
        };

        ctrl_z {
            bindings = <&kp LC(Z)>;
            key-positions = <25 24>;
            layers = <0>;
        };

        ctrl_y {
            bindings = <&kp LC(Y)>;
            key-positions = <13 14>;
            layers = <0>;
        };

        quote {
            bindings = <&kp DOUBLE_QUOTES>;
            key-positions = <7 8>;
            layers = <0>;
        };

        quote_single {
            bindings = <&kp SINGLE_QUOTE>;
            key-positions = <7 6>;
            layers = <0>;
        };

        num_enter {
            bindings = <&kp ENTER>;
            key-positions = <13 12 11 10>;
            layers = <0 1>;
        };

        num0 {
            bindings = <&kp N0>;
            key-positions = <13 12>;
            layers = <1>;
        };

        num5 {
            bindings = <&kp N5>;
            key-positions = <11 12>;
            layers = <1>;
        };

        vol_dn {
            bindings = <&kp C_VOLUME_DOWN>;
            key-positions = <23 22>;
            layers = <4>;
        };

        vol_up {
            bindings = <&kp C_VOLUME_UP>;
            key-positions = <24 23>;
            layers = <4>;
        };
    };
